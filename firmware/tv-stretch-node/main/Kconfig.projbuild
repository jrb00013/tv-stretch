## firmware/tv-stretch-node/main/Kconfig.projbuild
```kconfig
menu "TV Stretch Node Configuration"

    config TVS_WIFI_SSID
        string "WiFi SSID"
        default "myssid"
        help
            WiFi network name. Can be overridden via NVS key wifi_ssid.

    config TVS_WIFI_PASSWORD
        string "WiFi password"
        default "password"
        help
            WiFi password. Prefer provisioning; NVS key wifi_pass.

    config TVS_SERVER_WS_URL
        string "Coordinator WebSocket URL"
        default "ws://192.168.1.10:8000/ws/device"
        help
            Full WebSocket URL including path /ws/device

    config TVS_NODE_API_KEY
        string "Node API key"
        default "dev-node-key"
        help
            Bearer token for device authentication (override via NVS api_key).

    config TVS_ROOM_ID
        string "Room ID (UUID)"
        default "00000000-0000-0000-0000-000000000001"
        help
            Logical room this node is mounted in.

    config TVS_HOME_ID
        string "Home ID (UUID)"
        default "00000000-0000-0000-0000-000000000000"
        help
            Home / tenant identifier.

    config TVS_CEC_LOGICAL_ADDR
        int "CEC logical address for this node"
        default 4
        range 0 14
        help
            Logical address claimed on CEC bus. Playback 1 (0x04) is typical for a streaming stick.

    config TVS_CEC_GPIO
        int "GPIO number for HDMI CEC"
        default 4
        help
            ESP32-C3 GPIO wired to HDMI pin 13 (CEC).

    config TVS_CEC_RX_ENABLE
        bool "Enable CEC receive (GPIO interrupt decode)"
        default y
        help
            When enabled, monitors CEC line for incoming frames.

    config TVS_STATUS_LED_ENABLE
        bool "Enable status LED"
        default y
        help
            Blink GPIO on command batches.

    config TVS_STATUS_LED_GPIO
        int "Status LED GPIO"
        depends on TVS_STATUS_LED_ENABLE
        default 8
        help
            GPIO for activity LED (board dependent).

    config TVS_HEALTH_INTERVAL
        int "Health telemetry interval (seconds)"
        default 60
        range 10 3600
        help
            How often to log heap, RSSI, frame counts.

    config TVS_WATCHDOG_TIMEOUT
        int "Task watchdog timeout (seconds)"
        default 30
        range 5 300
        help
            ESP-TASK-WDT timeout; main loop feeds every 5s.

    config TVS_FW_VERSION
        string "Firmware version string"
        default "0.4.0"
        help
            Reported in hello JSON and OTA manifest compare.

    config TVS_HTTP_PROVISIONING
        bool "First-boot SoftAP + HTTP provisioning UI"
        default n
        help
            If y and NVS provisioned!=1, starts AP tv-stretch-setup. Join it and open http://192.168.4.1

    config TVS_PROV_AP_SSID
        string "Provisioning SoftAP SSID"
        depends on TVS_HTTP_PROVISIONING
        default "tv-stretch-setup"

    config TVS_PROV_AP_PASS
        string "Provisioning SoftAP password (min 8 chars)"
        depends on TVS_HTTP_PROVISIONING
        default "tvstretch1"

    config TVS_PROV_AP_CHANNEL
        int "Provisioning SoftAP channel"
        depends on TVS_HTTP_PROVISIONING
        default 1
        range 1 13

    config TVS_OTA_BOOT_MANIFEST_URL
        string "Optional: manifest URL to fetch on boot (empty to disable)"
        default ""
        help
            Example http://192.168.1.10:8000/ota/manifest

    config TVS_OTA_AUTO_CHECK_ON_BOOT
        bool "On boot: if manifest version != firmware version, run OTA"
        default n
        help
            Dangerous on misconfigured servers; prefer ota_pull command from coordinator.

endmenu
```

## firmware/tv-stretch-node/sdkconfig.defaults
```kconfig
CONFIG_ESPTOOLPY_FLASHMODE_QIO=y
CONFIG_ESPTOOLPY_FLASHFREQ_80M=y
CONFIG_ESP_MAIN_TASK_STACK_SIZE=12288
CONFIG_ESP_WIFI_STATIC_RX_BUFFER_NUM=10
CONFIG_ESP_WIFI_DYNAMIC_RX_BUFFER_NUM=32
CONFIG_ESP_CONSOLE_USB_SERIAL_JTAG=y

# Dual OTA partitions (see partitions.csv)
CONFIG_PARTITION_TABLE_CUSTOM=y
CONFIG_PARTITION_TABLE_CUSTOM_FILENAME="partitions.csv"

# Allow plain HTTP for LAN OTA pulls (do not expose raw Internet without TLS proxy)
CONFIG_ESP_HTTPS_OTA_ALLOW_HTTP=y

# HTTP provisioning UI
CONFIG_HTTPD_MAX_REQ_HDR_LEN=2048
CONFIG_HTTPD_MAX_URI_LEN=128
```
